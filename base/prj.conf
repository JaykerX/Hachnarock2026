## CMakeLists.txt
```
cmake_minimum_required(VERSION 3.20.0)
find_package(Zephyr REQUIRED HINTS $ENV{ZEPHYR_BASE})

project(untitled)

target_sources(app PRIVATE src/main.c)
```

## prj.conf
```kconfig
CONFIG_GPIO=y
CONFIG_NEWLIB_LIBC=y
CONFIG_FPU=y
CONFIG_CPP=y
CONFIG_STD_CPP17=y
CONFIG_NEWLIB_LIBC_NANO=y
CONFIG_UART_CONSOLE=n
CONFIG_PRINTK=n
```

## boards/nrf54l15dk.overlay
```dts
/ {
    chosen {
        zephyr,console = &cdc_acm_uart0;
        zephyr,shell-uart = &cdc_acm_uart0;
    };
};
```

## src/main.c
```c
#include <zephyr/kernel.h>
#include <zephyr/device.h>
#include <zephyr/drivers/gpio.h>
#include <zephyr/drivers/uart.h>
#include <stdlib.h>

#define LED_PORT DEVICE_DT_GET(DT_NODELABEL(gpio0))

#define P0_00 0
#define P0_01 1
#define P0_02 2
#define P0_03 3
#define P0_04 4
#define P0_05 5

static const uint8_t out_pins[] = {
    P0_00, P0_01, P0_02, P0_03
};

#define T0 0.3f
#define T1 0.4f
#define T2 0.7f
#define T3 0.8f

#define MIN_TRESHOLD_FRAMES 8

const struct device *uart = DEVICE_DT_GET(DT_CHOSEN(zephyr_console));

#define BUF_SIZE 32
static char rx_buf[BUF_SIZE];
static int rx_pos = 0;

static int above_t1_count = 0;
static int below_t1_count = 0;
static int found = 0;
static int prev_found = 0;

static void uart_send(const char *s)
{
    while (*s) {
        uart_poll_out(uart, *s++);
    }
}

void process_value(float v)
{
    int out = 0;

    if (v > T0) out |= (1 << 0);
    if (v > T1) out |= (1 << 1);
    if (v > T2) out |= (1 << 2);
    if (v > T3) out |= (1 << 3);

    for (int i = 0; i < 4; i++) {
        gpio_pin_set(LED_PORT, out_pins[i], (out >> i) & 1);
    }

    if (v > T1) {
        above_t1_count++;
        below_t1_count = 0;

        if (above_t1_count >= MIN_TRESHOLD_FRAMES) {
            found = 1;
        }
    } else {
        above_t1_count = 0;
        below_t1_count++;

        if (below_t1_count >= MIN_TRESHOLD_FRAMES * 4) {
            found = 0;
        }
    }

    if (found && !prev_found) {
        uart_send("DANGER\n");
    }

    prev_found = found;

    gpio_pin_set(LED_PORT, P0_04, found);
    gpio_pin_set(LED_PORT, P0_05, found);
}

int main(void)
{
    if (!device_is_ready(LED_PORT) || !device_is_ready(uart)) {
        return -1;
    }

    for (int i = 0; i < 4; i++) {
        gpio_pin_configure(LED_PORT, out_pins[i], GPIO_OUTPUT_LOW);
    }

    gpio_pin_configure(LED_PORT, P0_04, GPIO_OUTPUT_LOW);
    gpio_pin_configure(LED_PORT, P0_05, GPIO_OUTPUT_LOW);

    while (1) {
        uint8_t c;

        if (uart_poll_in(uart, &c) == 0) {

            if (c == '\n' || c == '\r') {
                rx_buf[rx_pos] = '\0';

                float val = strtof(rx_buf, NULL);

                if (val < 0.0f) val = 0.0f;
                if (val > 1.0f) val = 1.0f;

                process_value(val);

                rx_pos = 0;
            }
            else if (rx_pos < BUF_SIZE - 1) {
                rx_buf[rx_pos++] = c;
            }
        }

        k_msleep(1);
    }
}
```

## src/main.cpp
```c
#include <zephyr/kernel.h>
#include <zephyr/logging/log.h>
#include <zephyr/device.h>
#include <zephyr/drivers/uart.h>
#include <zephyr/drivers/gpio.h>

LOG_MODULE_REGISTER(hello_ei);

#define IMG_W 96
#define IMG_H 96
#define IMG_C 3
#define IMG_SIZE (IMG_W * IMG_H * IMG_C)

#define UART_NODE DT_CHOSEN(zephyr_console)
static const struct device *uart_dev = DEVICE_DT_GET(UART_NODE);

#define LED0_NODE DT_ALIAS(led0)
#define LED1_NODE DT_ALIAS(led1)
#define LED2_NODE DT_ALIAS(led2)
#define LED3_NODE DT_ALIAS(led3)

static const struct gpio_dt_spec leds[] = {
	GPIO_DT_SPEC_GET(LED0_NODE, gpios),
	GPIO_DT_SPEC_GET(LED1_NODE, gpios),
	GPIO_DT_SPEC_GET(LED2_NODE, gpios),
	GPIO_DT_SPEC_GET(LED3_NODE, gpios),
};

static const float thresholds[4] = {0.5f, 0.6f, 0.7f, 0.8f};

static uint8_t image_buffer[IMG_SIZE];

static int get_image_data(size_t offset, size_t length, float *out_ptr)
{
	for (size_t i = 0; i < length; i++) {
		out_ptr[i] = (float)image_buffer[offset + i] / 255.0f;
	}
	return 0;
}

static int uart_read_frame(uint8_t *buf, size_t len)
{
	uint8_t byte;

	while (1) {
		if (uart_poll_in(uart_dev, &byte) == 0 && byte == 0xAA) {
			if (uart_poll_in(uart_dev, &byte) == 0 && byte == 0x55) {
				break;
			}
		}
	}

	size_t idx = 0;

	while (idx < len) {
		if (uart_poll_in(uart_dev, &byte) == 0) {
			buf[idx++] = byte;
		}
	}

	return 0;
}

static void update_leds(float score)
{
	for (size_t i = 0; i < ARRAY_SIZE(leds); i++) {
		gpio_pin_set_dt(&leds[i], score >= thresholds[i]);
	}
}

static void run_inference(void)
{
	ei_impulse_result_t result;

	signal_t signal;
	signal.total_length = IMG_SIZE;
	signal.get_data = get_image_data;

	uint32_t start = k_cycle_get_32();

	EI_IMPULSE_ERROR err = run_classifier(&signal, &result, false);

	uint32_t time_us = k_cyc_to_us_floor32(k_cycle_get_32() - start);

	if (err != EI_IMPULSE_OK) {
		LOG_ERR("Inference failed (%d)", err);
		return;
	}

	LOG_INF("Inference time: %u us", time_us);

	float max_score = 0.0f;
	const char *max_label = nullptr;

	for (size_t i = 0; i < EI_CLASSIFIER_LABEL_COUNT; i++) {
		float val = result.classification[i].value;

		LOG_INF("%s: %.3f", result.classification[i].label, (double)val);

		if (val > max_score) {
			max_score = val;
			max_label = result.classification[i].label;
		}
	}

	LOG_INF("Top result: %s (%.3f)",
		max_label ? max_label : "unknown",
		(double)max_score);

	update_leds(max_score);
}

static int init_peripherals(void)
{
	if (!device_is_ready(uart_dev)) {
		LOG_ERR("UART not ready");
		return -1;
	}

	for (size_t i = 0; i < ARRAY_SIZE(leds); i++) {
		if (!device_is_ready(leds[i].port)) {
			LOG_ERR("LED %d not ready", i);
			return -1;
		}

		gpio_pin_configure_dt(&leds[i], GPIO_OUTPUT_INACTIVE);
	}

	return 0;
}

int main(void)
{
	LOG_INF("Starting FOMO UART inference (FIXED)");

	if (init_peripherals() != 0) {
		return -1;
	}

	while (1) {
		LOG_INF("Waiting for image frame...");

		uart_read_frame(image_buffer, IMG_SIZE);

		run_inference();
	}

	return 0;
}
```

## src/config.h
```c
#pragma once

#define IMG_W 128
#define IMG_H 128
#define IMG_SIZE (IMG_W * IMG_H)

#define USB_CHUNK_SIZE 64
#define RING_BUFFER_SIZE 8192

#define DETECT_COUNT_MIN 5
```

## src/frame_assembler.c
```c
#include "frame_assembler.h"
#include "ring_buffer.h"
#include "config.h"
#include <string.h>

static uint8_t frame[IMG_SIZE];

static int filled = 0;

bool frame_get(uint8_t *out_frame)
{
    uint8_t tmp[64];

    while (rb_available() >= 64 && filled < IMG_SIZE) {

        rb_read(tmp, 64);

        for (int i = 0; i < 64 && filled < IMG_SIZE; i++) {
            frame[filled++] = tmp[i];
        }
    }

    if (filled >= IMG_SIZE) {
        memcpy(out_frame, frame, IMG_SIZE);
        filled = 0;
        return true;
    }

    return false;
}
```

## src/frame_assembler.h
```c
#pragma once
#include <stdint.h>
#include <stdbool.h>

bool frame_get(uint8_t *out_frame);
```

## src/gpio_output.c
```c
#include "gpio_output.h"
#include "state_machine.h"

#include <zephyr/drivers/gpio.h>
#include <zephyr/kernel.h>

#define LED DT_ALIAS(led0)

static const struct gpio_dt_spec led = GPIO_DT_SPEC_GET(LED, gpios);

void gpio_thread(void)
{
    gpio_pin_configure_dt(&led, GPIO_OUTPUT);

    while (1) {
        gpio_pin_set_dt(&led, get_danger());
        k_msleep(20);
    }
}

K_THREAD_DEFINE(gpio_t, 1024, gpio_thread, NULL, NULL, NULL, 2, 0, 0);
```

## src/gpio_output.h
```c
#pragma once

void gpio_thread(void);
```

## src/ring_buffer.c
```c
#include "ring_buffer.h"
#include "config.h"

static uint8_t buffer[RING_BUFFER_SIZE];

static volatile int head = 0;
static volatile int tail = 0;

void rb_init(void)
{
    head = tail = 0;
}

int rb_write(const uint8_t *data, size_t len)
{
    for (int i = 0; i < len; i++) {

        int next = (head + 1) % RING_BUFFER_SIZE;

        if (next == tail) return i;

        buffer[head] = data[i];
        head = next;
    }

    return len;
}

int rb_read(uint8_t *out, size_t len)
{
    int i = 0;

    while (i < len && tail != head) {
        out[i++] = buffer[tail];
        tail = (tail + 1) % RING_BUFFER_SIZE;
    }

    return i;
}

int rb_available(void)
{
    if (head >= tail) return head - tail;
    return RING_BUFFER_SIZE - tail + head;
}
```

## src/ring_buffer.h
```c
#pragma once
#include <stdint.h>
#include <stdbool.h>
#include <stddef.h>

void rb_init(void);
int rb_write(const uint8_t *data, size_t len);
int rb_read(uint8_t *out, size_t len);
int rb_available(void);
```

## src/state_machine.c
```c
#include "state_machine.h"
#include "config.h"

static int detect_cnt = 0;
static int miss_cnt = 0;
static uint8_t DANGER = 0;

uint8_t get_danger(void)
{
    return DANGER;
}

void update_state(bool detected)
{
    if (detected) {

        detect_cnt++;
        miss_cnt = 0;

        if (detect_cnt >= DETECT_COUNT_MIN)
            DANGER = 1;

    } else {

        miss_cnt++;
        detect_cnt = 0;

        if (miss_cnt >= DETECT_COUNT_MIN)
            DANGER = 0;
    }
}
```

## src/state_machine.h
```c
#pragma once
#include <stdbool.h>
#include <stdint.h>

void state_machine_init(void);
void update_state(bool detected);
uint8_t get_danger(void);
```

## src/usb_dma.c
```c
#include <zephyr/device.h>
#include <zephyr/drivers/uart.h>
#include <zephyr/logging/log.h>

#include "ring_buffer.h"

LOG_MODULE_REGISTER(usb, 3);

static const struct device *cdc_dev;

static void cdc_acm_callback(const struct device *dev,
                             struct uart_event *evt,
                             void *user_data)
{
    switch (evt->type) {

    case UART_RX_RDY:
        rb_write(evt->data.rx.buf, evt->data.rx.len);
        break;

    case UART_RX_DISABLED:
        uart_rx_enable(dev, NULL, 0, SYS_FOREVER_MS);
        break;

    default:
        break;
    }
}

static const struct device *cdc_dev;

void usb_init(void)
{
    cdc_dev = device_get_binding("CDC_ACM_0");

    if (!cdc_dev) {
        LOG_ERR("CDC ACM not found");
        return;
    }

    int ret = uart_callback_set(cdc_dev, cdc_acm_callback, NULL);
    if (ret) {
        LOG_ERR("uart_callback_set failed (%d)", ret);
        return;
    }

    ret = uart_rx_enable(cdc_dev, NULL, 0, SYS_FOREVER_MS);
    if (ret) {
        LOG_ERR("uart_rx_enable failed (%d)", ret);
        return;
    }

    LOG_INF("USB CDC ACM initialized");
}
```

## src/usb_dma.h
```c
#pragma once
#include <stdint.h>
#include <stddef.h>

void usb_init(void);
void usb_rx_callback(const uint8_t *data, size_t len);
```
